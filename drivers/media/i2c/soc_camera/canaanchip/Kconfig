## drivers/media/i2c/soc_camera/canaanchip/Kconfig
```kconfig
config VIDEO_IMX219_0
	tristate "Sony IMX219 sensor support"
	depends on I2C && VIDEO_V4L2 && VIDEO_V4L2_SUBDEV_API && VIDEO_CANAAN_K510
	depends on MEDIA_CAMERA_SUPPORT
	---help---
	  This is a V4L2 sensor-level driver for the Sony IMX219
	  CMOS image sensor.
config VIDEO_IMX219_1
	tristate "Sony IMX219 sensor support"
	depends on I2C && VIDEO_V4L2 && VIDEO_V4L2_SUBDEV_API && VIDEO_CANAAN_K510
	depends on MEDIA_CAMERA_SUPPORT
	---help---
	  This is a V4L2 sensor-level driver for the Sony IMX219
	  CMOS image sensor.

config VIDEO_IMX385
        tristate "Sony IMX385 sensor support"
        depends on I2C && VIDEO_V4L2 && VIDEO_V4L2_SUBDEV_API && VIDEO_CANAAN_K510
        depends on MEDIA_CAMERA_SUPPORT
        ---help---
          This is a V4L2 sensor-level driver for the Sony IMX385
          CMOS image sensor.

config VIDEO_GC2053
	tristate "Galaxycore GC2053 sensor support"
	depends on I2C && VIDEO_V4L2 && VIDEO_V4L2_SUBDEV_API && VIDEO_CANAAN_K510
	depends on MEDIA_CAMERA_SUPPORT
	---help---
	  This is a V4L2 sensor-level driver for the Galaxycore GC2053
	  CMOS image sensor.

config VIDEO_GC2093
        tristate "Galaxycore GC2093 sensor support"
        depends on I2C && VIDEO_V4L2 && VIDEO_V4L2_SUBDEV_API && VIDEO_CANAAN_K510
        depends on MEDIA_CAMERA_SUPPORT
        ---help---
          This is a V4L2 sensor-level driver for the Galaxycore GC2093
          CMOS image sensor.

config VIDEO_GC2145
        tristate "Galaxycore GC2145 sensor support"
        depends on I2C && VIDEO_V4L2 && VIDEO_V4L2_SUBDEV_API && VIDEO_CANAAN_K510
        depends on MEDIA_CAMERA_SUPPORT
        ---help---
          This is a V4L2 sensor-level driver for the Galaxycore GC2145
          CMOS image sensor.

config VIDEO_SC035HGS
        tristate "SmartSens SC035HGS sensor support"
        depends on I2C && VIDEO_V4L2 && VIDEO_V4L2_SUBDEV_API && VIDEO_CANAAN_K510
        depends on MEDIA_CAMERA_SUPPORT
        ---help---
          This is a V4L2 sensor-level driver for the SmartSens SC035HGS
          CMOS image sensor.
```
